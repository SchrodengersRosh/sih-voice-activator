## firmware/main/Kconfig.projbuild
```kconfig
menu "SIH Voice Activator Configuration"

    menu "Wi-Fi Configuration"
        config SIH_WIFI_SSID
            string "Wi-Fi SSID"
            default "Nullpointer-2.4G"
            help
                SSID of the Wi-Fi network to connect to.

        config SIH_WIFI_PASSWORD
            string "Wi-Fi Password"
            default ""
            help
                Password of the Wi-Fi network.
    endmenu

    menu "Backend Server Configuration"
        config SIH_SERVER_HOST
            string "Backend Server Host / IP"
            default "192.168.1.8"
            help
                IP address or hostname of the Mac/backend running Python VoiceServer.

        config SIH_SERVER_PORT
            int "Backend Server Port"
            default 8765
            range 1 65535
            help
                Port of the backend WebSocket server (default: 8765).

        config SIH_SERVER_PATH
            string "Backend WebSocket Endpoint Path"
            default "/v1/stream"
            help
                Endpoint path for WebSocket streaming (frozen protocol: /v1/stream).

        config SIH_SERVER_URI
            string "Backend WebSocket Server Full URI (Optional Override)"
            default ""
            help
                Optional full URI override (e.g. ws://192.168.1.8:8765/v1/stream).
                If left empty, URI is constructed from SIH_SERVER_HOST, SIH_SERVER_PORT, and SIH_SERVER_PATH.

        config SIH_DEVICE_ID
            string "Device ID"
            default "esp32s3-voice-01"
            help
                Device identifier sent in the hello handshake message.
    endmenu

    menu "I2S Microphone Configuration"
        config SIH_I2S_SCK_GPIO
            int "I2S Bit Clock (SCK/BCLK) GPIO"
            default 4
            range 0 48
            help
                GPIO pin connected to I2S SCK / BCLK.

        config SIH_I2S_WS_GPIO
            int "I2S Word Select (WS/LRCLK) GPIO"
            default 5
            range 0 48
            help
                GPIO pin connected to I2S WS / LRCLK.

        config SIH_I2S_DIN_GPIO
            int "I2S Data In (SD/DIN) GPIO"
            default 6
            range 0 48
            help
                GPIO pin connected to I2S SD / DOUT of microphone.

        config SIH_I2S_32BIT_SLOT
            bool "Microphone uses 24-bit in 32-bit slot (e.g. INMP441)"
            default y
            help
                Select 'y' if microphone outputs 24-bit samples in 32-bit slots.
                The driver will extract and scale to canonical signed 16-bit mono PCM.
    endmenu

    menu "Audio & Detection Settings"
        config SIH_ENERGY_THRESHOLD_DB
            int "Energy Gate Threshold (dBFS)"
            default -50
            range -90 0
            help
                Energy gate threshold in dBFS. Samples below this energy skip KWS inference
                to minimize power per DEC-INFER-011.

        config SIH_PREBUFFER_MS
            int "Pre-buffer duration (ms)"
            default 800
            help
                Duration of audio captured prior to wake-word detection (frozen protocol: 800ms).

        config SIH_STREAM_DURATION_MS
            int "Live audio stream duration after trigger (ms)"
            default 3000
            range 1000 10000
            help
                Duration of live microphone audio streamed to backend after wake-word detection.
    endmenu

endmenu
```

## firmware/sdkconfig.defaults
```kconfig
# ESP32-S3 Target Configuration
CONFIG_IDF_TARGET="esp32s3"
CONFIG_IDF_TARGET_ESP32S3=y

# System Performance & CPU
CONFIG_ESP_DEFAULT_CPU_FREQ_MHZ_240=y
CONFIG_ESP_DEFAULT_CPU_FREQ_MHZ=240
CONFIG_FREERTOS_HZ=1000

# Compiler Optimization
CONFIG_COMPILER_OPTIMIZATION_PERF=y

# FreeRTOS & Stack
CONFIG_ESP_MAIN_TASK_STACK_SIZE=8192
CONFIG_ESP_SYSTEM_EVENT_TASK_STACK_SIZE=4096

# Wi-Fi Configuration
# DEC-ESP32-009 / docs/hardware.md: Disable Wi-Fi power saving for minimal latency
CONFIG_ESP_WIFI_STATIC_RX_BUFFER_NUM=16
CONFIG_ESP_WIFI_DYNAMIC_RX_BUFFER_NUM=32
CONFIG_ESP_WIFI_DYNAMIC_TX_BUFFER_NUM=32

# Lightweight TCP/IP
CONFIG_LWIP_TCP_MSS=1440
CONFIG_LWIP_TCP_SND_BUF_DEFAULT=5760
CONFIG_LWIP_TCP_WND_DEFAULT=5760

# WebSocket Client
CONFIG_WS_BUFFER_SIZE=2048

# I2S Driver (Modern ESP-IDF v5 driver)
CONFIG_I2S_ISR_IRAM_SAFE=y
```
